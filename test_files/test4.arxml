AUTOSAR XML
ContainerB ()  # AA
  ContainerC ()  # BB
  ContainerA ()  # CC
ContainerA ()  # BB
  ContainerC ()  # BB
  ContainerB ()  # CC
